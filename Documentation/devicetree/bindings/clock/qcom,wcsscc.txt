## Documentation/devicetree/bindings/clock/qcom,wcsscc.txt
```
Qualcomm WCSS Clock Controller Binding
-----------------------------------------------

Required properties :
- compatible		: shall contain "qcom,qcs404-wcsscc"
- #clock-cells		: from common clock binding, shall contain 1.
- reg			: shall contain base register address and size,
			  in the order
			Index-0 maps to WCSS_Q6SSTOP clocks register region
			Index-1 maps to WCSS_TCSR register region
			Index-2 maps to WCSS_QDSP6SS register region

Optional properties :
- reg-names	: register names of WCSS domain
		 "wcss_q6sstop", "wcnss_tcsr", "wcss_qdsp6ss".

Example:
The below node has to be defined in the cases where the WCSS peripheral loader
would bring the subsystem out of reset.

	clock_wcsscc: qcom,wcsscc@7000000 {
		compatible = "qcom,qcs404-wcsscc";
		reg = <0x07500000 0x4e000>, <0x07550000 0x8012>, <0x07400000 0x104>;
		reg-names = "wcss_q6sstop", "wcnss_tcsr", "wcss_qdsp6ss";
		#clock-cells = <1>;
	};
```

## Documentation/devicetree/bindings/display/rockchip/cdn-dp-rockchip.txt
```
Rockchip RK3399 specific extensions to the cdn Display Port
================================

Required properties:
- compatible: must be "rockchip,rk3399-cdn-dp"

- reg: physical base address of the controller and length

- clocks: from common clock binding: handle to dp clock.

- clock-names: from common clock binding:
	       Required elements: "core-clk" "pclk" "spdif"

- rockchip,grf: this soc should set GRF regs, so need get grf here.

- ports: contain a port nodes with endpoint definitions as defined in
	 Documentation/devicetree/bindings/media/video-interfaces.txt.
	 contained 2 endpoints, connecting to the output of vop.

- phys: from general PHY binding: the phandle for the PHY device.

- extcon: extcon specifier for the Power Delivery

- #sound-dai-cells = it must be 1 if your system is using 2 DAIs: I2S, SPDIF

-------------------------------------------------------------------------------

Example:
	cdn_dp: dp@fec00000 {
		compatible = "rockchip,rk3399-cdn-dp";
		reg = <0x0 0xfec00000 0x0 0x100000>;
		interrupts = <GIC_SPI 9 IRQ_TYPE_LEVEL_HIGH>;
		clocks = <&cru SCLK_DP_CORE>, <&cru PCLK_DP_CTRL>,
			 <&cru SCLK_SPDIF_REC_DPTX>;
		clock-names = "core-clk", "pclk", "spdif";
		phys = <&tcphy0>;
		extcon = <&fusb1>;
		rockchip,grf = <&grf>;
		#address-cells = <1>;
		#size-cells = <0>;
		#sound-dai-cells = <1>;

		ports {
			#address-cells = <1>;
			#size-cells = <0>;

			dp_in: port {
				#address-cells = <1>;
				#size-cells = <0>;
				dp_in_vopb: endpoint@0 {
					reg = <0>;
					remote-endpoint = <&vopb_out_dp>;
				};

				dp_in_vopl: endpoint@1 {
					reg = <1>;
					remote-endpoint = <&vopl_out_dp>;
				};
			};
		};
	};
```

## Documentation/devicetree/bindings/net/qcom,ethqos-qcs404.txt
```
Qualcomm ethqos qcs404

Required properties:

 - compatible			: Should be "qcom,ethqos-qcs404"
```

## Documentation/devicetree/bindings/net/realtek-8211e.txt
```
Realtek RTL8211E Ethernet phy

Realtek phy driver is matched and probed by phy_id automatically,
and hence not property required.

Optional properties:
- enable-phy-ssc : Enable phy spread spectrum clock(SSC)
```

## Documentation/devicetree/bindings/rtc/google,cros-ec-rtc.txt
```
* Chromium OS EC RTC

The Chromium OS EC can function as an RTC in systems that lack a discrete
RTC device. The RTC supports basic time and alarm functions, including alarms
that can wake up the device from suspend.

An EC RTC node should be only found as a sub-node of the EC node (see
Documentation/devicetree/bindings/mfd/cros-ec.txt).

Required properties:
- compatible: Must contain "google,cros-ec-rtc"

Example:
	cros-ec@0 {
		compatible = "google,cros-ec-spi";

		...

		cros_ec_rtc: ec-rtc {
			compatible = "google,cros-ec-rtc";
		};
	};
```

## Documentation/devicetree/bindings/security/tpm/cr50_spi.txt
```
* H1 Secure Microcontroller with Cr50 Firmware on SPI Bus.

H1 Secure Microcontroller running Cr50 firmware provides several
functions, including TPM-like functionality. It communicates over
SPI using the FIFO protocol described in the PTP Spec, section 6.

Required properties:
- compatible: Should be "google,cr50".
- spi-max-frequency: Maximum SPI frequency.

Optional properties:
- access-delay-ms: Required delay between subsequent transactions on SPI.
- sleep-delay-ms: Time after the last SPI activity, after which the chip
  may go to sleep.
- wake-start-delay-ms: Time after initiating wake up before the chip is
  ready to accept commands over SPI.

Example:

&spi0 {
        status = "okay";

        cr50@0 {
                compatible = "google,cr50";
                reg = <0>;
                spi-max-frequency = <800000>;

                access-delay-ms = <2>;
                sleep-delay-ms = <1000>;
                wake-start-delay-ms = <60>;
        };
};
```

## drivers/apex/Kconfig
```kconfig
menu "DS devices"

config DS
  tristate "DS framework"
  depends on PCI
  help
  This framework supports DS, such as Knoll and Apex. It is required
  for either of those modules.

  To compile this driver as a module, choose M here.  The module
  will be called ds.

config DWN
  tristate "Dwn Driver"
  depends on DS
  help
  This driver supports the Dwn device.  Say Y if you want to
  include this driver in the kernel.

  To compile this driver as a module, choose M here.  The module
  will be called dwn.

endmenu
```

## drivers/gpu/drm/img-rogue/Kconfig
```kconfig
config DRM_POWERVR_ROGUE
	tristate "PowerVR Rogue"
	depends on ARM64 || X86
	depends on HAS_IOMEM
	depends on DRM
	depends on BROKEN
	select DRM_KMS_HELPER
	select PM_DEVFREQ
	select DEVFREQ_GOV_SIMPLE_ONDEMAND
	select PM_OPP
	select DEVFREQ_THERMAL
	help
	  Driver for PowerVR Rogue graphics hardware.

	  Say Y here if your SoC contains a PowerVR Rogue GPU. For more
	  information, see <http://www.imgtec.com/powervr/>.

config DRM_POWERVR_ROGUE_1_7
	tristate "PowerVR Rogue v1.7"
	depends on ARM64 || X86
	depends on HAS_IOMEM
	depends on DRM
	depends on (DRM_POWERVR_ROGUE!=m && m) || (DRM_POWERVR_ROGUE!=y && y)
	depends on BROKEN
	select DRM_KMS_HELPER
	select PM_DEVFREQ
	select DEVFREQ_GOV_SIMPLE_ONDEMAND
	select PM_OPP
	select DEVFREQ_THERMAL
	help
	  Driver for PowerVR Rogue graphics hardware, 1.7.

	  Say Y here if your SoC contains a PowerVR Rogue GPU. For more
	  information, see <http://www.imgtec.com/powervr/>.

config DRM_POWERVR_ROGUE_DEBUG
	bool "Enable PowerVR Rogue debug features"
	depends on DRM_POWERVR_ROGUE
	default n
	help
	  Add additional debug features to the PowerVR Rogue driver.

config DRM_POWERVR_ROGUE_PDUMP
	bool "Enable PowerVR Rogue PDUMP tracing."
	depends on DRM_POWERVR_ROGUE
	default n
	help
	  Enable PDUMP.
```

## drivers/iio/counter/Kconfig
```kconfig
#
# Counter devices
#
# When adding new entries keep the list in alphabetical order

menu "Counters"
endmenu
```

## drivers/media/pci/intel/ipu3/Kconfig
```kconfig
config VIDEO_IPU3_ACPI
	tristate
	depends on ACPI
	---help---
	   This helper library exports functions to be used by the IPU3
	   drivers to enumerate the sensors and VCM through ACPI.

config VIDEO_IPU3_CIO2
	tristate "Intel ipu3-cio2 driver"
	depends on VIDEO_DEV && PCI
	depends on HAS_DMA
	depends on ACPI
	depends on 64BIT
	select VIDEO_IPU3_ACPI
	select VIDEOBUF2_DMA_SG
	select V4L2_FWNODE
	---help---
	This is the video4linux2 driver for Intel IPU3 CSI2 receiver unit,
	found in Intel Skylake and Kaby Lake SoCs and used for capturing
	images and video from a camera sensor.

	Say Y or M here if you have a Skylake/Kaby Lake SoC with a camera.
	The module will be called ipu3-cio2.

config VIDEO_IPU3_IMGU
	tristate "Intel ipu3-imgu driver"
	depends on PCI && VIDEO_V4L2 && IOMMU_SUPPORT
	depends on MEDIA_CONTROLLER && VIDEO_V4L2_SUBDEV_API
	depends on X86_64
	select INTEL_IPU3_MMU
	select INTEL_IPU3_DMAMAP
	select VIDEOBUF2_DMA_SG
	---help---
	This is the video4linux2 driver for Intel IPU3 image processing unit,
	found in Intel Skylake and Kaby Lake SoCs and used for processing
	images and video.

	Say Y or M here if you have a Skylake/Kaby Lake SoC with a MIPI
	camera.	The module will be called ipu3-imgu.

config INTEL_IPU3_MMU
	tristate
	default n
	select IOMMU_API
	select IOMMU_IOVA
	---help---
	  For IPU3, this option enables its MMU driver to translate its internal
	  virtual address to 39 bits wide physical address for 64GBytes space access.

	  Say Y here if you have Skylake/Kaby Lake SoC with IPU3.
	  Say N if un-sure.

config INTEL_IPU3_DMAMAP
	tristate
	default n
	select IOMMU_DMA
	select IOMMU_IOVA
	---help---
	This is IPU3 IOMMU domain specific DMA driver.
```

## drivers/misc/throttler/Kconfig
```kconfig
# SPDX-License-Identifier: GPL-2.0

menuconfig THROTTLER
	bool "Throttler support"
	depends on OF
	help
	  This option enables core support for non-thermal throttling of CPUs
	  and devfreq devices.

	  Note that you also need a event monitor module usually called
	  *_throttler.

if THROTTLER

menuconfig THROTTLER_DEBUG
	bool "Enable throttler debugging"
	help
	  This option enables throttler debugging features like additional
	  logging and a debugfs attribute for setting the logging level.

	  Choose N unless you want to debug throttler drivers.

endif # THROTTLER
```
